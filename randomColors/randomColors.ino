#include "Arduino_is31fl3733.h"


Arduino_is31fl3733 disp0(ADDR_GND, ADDR_GND);
Arduino_is31fl3733 disp1(ADDR_GND, ADDR_SCL);
Arduino_is31fl3733 disp2(ADDR_GND, ADDR_SDA);
Arduino_is31fl3733 disp3(ADDR_GND, ADDR_VCC);

Arduino_is31fl3733 disp4(ADDR_SCL, ADDR_GND);
Arduino_is31fl3733 disp5(ADDR_SCL, ADDR_SCL);
Arduino_is31fl3733 disp6(ADDR_SCL, ADDR_SDA);
Arduino_is31fl3733 disp7(ADDR_SCL, ADDR_VCC);

Arduino_is31fl3733 disp8(ADDR_SDA, ADDR_GND);
Arduino_is31fl3733 disp9(ADDR_SDA, ADDR_SCL);
Arduino_is31fl3733 disp10(ADDR_SDA, ADDR_SDA);
Arduino_is31fl3733 disp11(ADDR_SDA, ADDR_VCC);

Arduino_is31fl3733 disp12(ADDR_VCC, ADDR_GND);
Arduino_is31fl3733 disp13(ADDR_VCC, ADDR_SCL);
Arduino_is31fl3733 disp14(ADDR_VCC, ADDR_SDA);

#define displays 12
Arduino_is31fl3733 disp[displays] = {

  //disp0
  
  disp0, disp1, disp2, disp3, disp4, disp5,
  disp6, disp7, disp8, 
  disp9, 
  disp10, 
   disp11, 
   // disp12, disp13 ,disp14
  };


uint8_t rows[4][16] = {
  { 44, 43, 34, 33, 24, 23, 14, 13,  4,  3, 42, 32, 22, 12,  2,  1 },
  {  0, 47, 46, 45, 37, 36, 35, 27, 26, 25, 17, 16, 15,  7,  6,  5 },
  { 11, 10,  9,  8,  0,  0,  0,  0,  0,  0,  0,  0,  0,  0,  0,  0 },
  { 51, 50, 49, 48, 41, 40, 39, 38, 31, 30, 29, 28, 21, 20, 19, 18 }
};


uint8_t mirrorColors[51][3] = {
  {0xFF, 0x00, 0xFF},
  {0x00, 0x00, 0x00},
  {0x00, 0x00, 0x00},
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  {0x00, 0x00, 0xFF},  
};

uint8_t colors[51][3] = {

   {0x88, 0x00, 0x00},
   {0x77, 0x00, 0x10},
   {0x66, 0x00, 0x20},
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   {0x99, 0x00, 0x00}
};


uint8_t black[192];
uint8_t led_states[192];
uint8_t randomColors[192];

uint8_t red[192];
uint8_t yellow[192];
uint8_t orange[192];
uint8_t green[192];
uint8_t blue[192];
uint8_t purple[192];

uint8_t colorsRainbowForMatrix[12][3] = {
  {255,   0,   0}, // red
  {255, 127,   0}, // yellow
  {127, 127,   0}, // yellow
  {127, 255,   0}, // green
  {  0, 255,   0}, // green
  {  0, 255, 127}, // tuerkis
  
  {  0, 127, 127}, // tuerkis
  {  0, 127, 255}, // tuerkis
  {  0,   0, 255}, // tuerkis
  {127,   0, 255}, // blue
  {127,   0, 127}, // pink
  {255,   0, 127}, // pink
};

uint8_t colorsForMatrix[12][3] = {
  { 255, 255, 255},
  { 127,   0, 127},
  {  32,   0,  16},
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  {   0,   0,   0},
  
  
};

uint8_t matrixColors[12][192];


unsigned long myTime;

void setup()
{
  Wire.begin();
  //Wire.setClock(400000);
    Wire.setClock(400000);

  
  Serial.begin(115200);
  while (!Serial){}
  Serial.println("Starting");

  for (uint8_t i=0; i<192; i++){
    led_states[i] = IS31FL3733_LED_STATE_ON;
    randomColors[i] = random(255);
  }

  for (uint8_t j=0; j<12; j++){
    for (uint8_t k=0; k<4; k++){
      for (uint8_t i=0; i<16; i++){
      
        matrixColors[j][k*48+i+0] = colorsForMatrix[j][0];
        matrixColors[j][k*48+i+16] = colorsForMatrix[j][1];
        matrixColors[j][k*48+i+32] = colorsForMatrix[j][2];
      }
    }
  }
  

  for (uint8_t i = 0; i < displays; i++)
  {
    disp[i].Init();
    disp[i].SetGCC(0x10);
    disp[i].SetState(led_states);
    disp[i].SetPWM(black);
  }

   myTime = millis();
}


uint8_t fps = 0;
uint8_t offset = 0;

void loop() {
  
  if (millis() - myTime > 1000)
  {
    Serial.print("Frames: ");
    Serial.println(fps);
    fps = 0;
    myTime = millis();
  }
  
  for (uint8_t i = 0; i < displays; i++)
  {
    disp[i].SetPWM(matrixColors[(i+offset)%12]);
  }
  
  fps++;
  offset++;
  if (offset > 12) offset = 0;

}
