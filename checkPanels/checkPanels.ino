
// lets see if this overwrites speed
// #define NRFX_TWIM_DEFAULT_CONFIG_FREQUENCY 0xFF00000
// #include "nrfx_twim.h"


#include "Arduino_is31fl3733.h"

// NRFX_TWIM_DEFAULT_CONFIG_FREQUENCY
Arduino_is31fl3733 disp0(ADDR_GND, ADDR_GND);
Arduino_is31fl3733 disp1(ADDR_GND, ADDR_SCL);
Arduino_is31fl3733 disp2(ADDR_GND, ADDR_SDA);
Arduino_is31fl3733 disp3(ADDR_GND, ADDR_VCC);

Arduino_is31fl3733 disp4(ADDR_SCL, ADDR_GND);
Arduino_is31fl3733 disp5(ADDR_SCL, ADDR_SCL);
Arduino_is31fl3733 disp6(ADDR_SCL, ADDR_SDA);
Arduino_is31fl3733 disp7(ADDR_SCL, ADDR_VCC);

Arduino_is31fl3733 disp8(ADDR_SDA, ADDR_GND);
Arduino_is31fl3733 disp9(ADDR_SDA, ADDR_SCL);
Arduino_is31fl3733 disp10(ADDR_SDA, ADDR_SDA);
Arduino_is31fl3733 disp11(ADDR_SDA, ADDR_VCC);

Arduino_is31fl3733 disp12(ADDR_VCC, ADDR_GND);
//Arduino_is31fl3733 disp13(ADDR_VCC, ADDR_SCL);
Arduino_is31fl3733 disp14(ADDR_VCC, ADDR_SDA);
//Arduino_is31fl3733 disp14(ADDR_VCC, ADDR_VCC);


int power_pin = 13;



// double ﻿dA = 116.56505;

/*
{90,0}
{dA-90,0}
{dA-90,72}
{dA-90,144}
{dA-90,216}
{dA-90,288}

{-90,0}
{-(dA-90),180}
{-(dA-90),252}
{-(dA-90),324}
{-(dA-90),36}
{-(dA-90),108}
*/


#define displays 12
Arduino_is31fl3733 disp[displays] = {

  //disp0
  
  disp0, disp1, disp2, disp3,  disp4, 
  disp5,
  disp6, disp7, disp8, 
  disp9, 
  disp10, 
   disp12, 
   //disp12, 
// disp13 ,disp14
  };


uint8_t rows[4][16] = {
  { 44, 43, 34, 33, 24, 23, 14, 13,  4,  3, 42, 32, 22, 12,  2,  1 },
  {  0, 47, 46, 45, 37, 36, 35, 27, 26, 25, 17, 16, 15,  7,  6,  5 },
  { 11, 10,  9,  8,  0,  0,  0,  0,  0,  0,  0,  0,  0,  0,  0,  0 },
  { 51, 50, 49, 48, 41, 40, 39, 38, 31, 30, 29, 28, 21, 20, 19, 18 }
};

uint8_t sixColors[12][3] {
  {0xFF, 0x00, 0x00},
  {0xFF, 0xFF, 0x00},
  {0x00, 0xFF, 0x00},
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  {0x00, 0xFF, 0x00}
};

uint8_t mirrorColors[51][3] = {
{0xFF, 0x00, 0xFF},
  {0x00, 0x00, 0x00},
  {0x00, 0x00, 0x00},
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  {0x00, 0x00, 0xFF},  
};

uint8_t colors[51][3] = {

   {0x88, 0x00, 0x00},
   {0x77, 0x00, 0x10},
   {0x66, 0x00, 0x20},
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   {0x99, 0x00, 0x00}
};

void setup()
{

  pinMode (power_pin, OUTPUT);
  digitalWrite(power_pin, LOW);
  
  // Wire1.setClock(100000);
  //Serial.begin(9600);
  //Serial.println("Starting");

  for (uint8_t i = 0; i < displays; i++)
  {
    disp[i].Init();
    disp[i].SetGCC(0x10); //was F0 but capacitors are singing

    for (uint8_t i_cs = 0; i_cs < 16; i_cs++) {
      for (uint8_t i_sw = 0; i_sw < 12; i_sw++) {
        disp[i].SetLEDPWM(i_cs, i_sw, 0);
        disp[i].SetLEDState(i_cs, i_sw, IS31FL3733_LED_STATE_ON);
      }
    }
  }
}

void loop() {
  
  for (uint8_t i = 0; i < displays; i++)
  {
    //waiting for input
    uint8_t x = 0;

    for (uint8_t i_sw = 0; i_sw < 4; i_sw++) {
      for (uint8_t i_cs = 0; i_cs < 16; i_cs++) {
        //      uint8_t val = (uint8_t) random(0, 32);

        uint8_t led = rows[i_sw][i_cs];
        if (led > 0)
        {
          disp[i].SetLEDPWM(i_cs, i_sw * 3 + 0, sixColors[i][0]);
          disp[i].SetLEDPWM(i_cs, i_sw * 3 + 1, sixColors[i][1]);
          disp[i].SetLEDPWM(i_cs, i_sw * 3 + 2, sixColors[i][2]);
        }
      }
    }
  }
  
  delay(3000);

  for (uint8_t c=0;c<6;c++) {
    for (uint8_t i = 0; i < displays; i++)
    {
      //waiting for input
      uint8_t x = 0;
  
      for (uint8_t i_sw = 0; i_sw < 4; i_sw++) {
        for (uint8_t i_cs = 0; i_cs < 16; i_cs++) {
          //      uint8_t val = (uint8_t) random(0, 32);
  
          uint8_t led = rows[i_sw][i_cs];
          if (led > 0)
          {
            disp[i].SetLEDPWM(i_cs, i_sw * 3 + 0, sixColors[c][0]);
            disp[i].SetLEDPWM(i_cs, i_sw * 3 + 1, sixColors[c][1]);
            disp[i].SetLEDPWM(i_cs, i_sw * 3 + 2, sixColors[c][2]);
          }
        }
      }
    }
    delay(1000);
  }

  for (uint8_t i = 0; i < displays; i++)
  { 
    //Serial.println("let's leave");
    for (uint8_t i_cs = 0; i_cs < 16; i_cs++) {
      for (uint8_t i_sw = 0; i_sw < 12; i_sw++) {
        disp[i].SetLEDPWM(i_cs, i_sw, 0);
      }
    }
  }
  
  delay(4000);
  
}
